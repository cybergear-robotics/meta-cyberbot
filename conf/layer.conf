## conf/layer.conf
```bitbake
# We have a conf and classes directory, add to BBPATH
BBPATH .= ":${LAYERDIR}"

# We have recipes-* directories, add to BBFILES
BBFILES += "${LAYERDIR}/recipes-*/*/*.bb \
            ${LAYERDIR}/recipes-*/*/*.bbappend"

BBFILE_COLLECTIONS += "meta-cyberbot"
BBFILE_PATTERN_meta-cyberbot = "^${LAYERDIR}/"
BBFILE_PRIORITY_meta-cyberbot = "6"

LAYERDEPENDS_meta-cyberbot = "core ros-common-layer ros2-jazzy-layer ros2-layer"
LAYERSERIES_COMPAT_meta-cyberbot = "scarthgap"
```
